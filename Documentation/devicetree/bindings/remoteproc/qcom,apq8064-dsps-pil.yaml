## Documentation/devicetree/bindings/remoteproc/qcom,apq8064-dsps-pil.yaml
```yaml
# SPDX-License-Identifier: (GPL-2.0-only OR BSD-2-Clause)
%YAML 1.2
---
$id: http://devicetree.org/schemas/remoteproc/qcom,apq8064-dsps-pil.yaml#
$schema: http://devicetree.org/meta-schemas/core.yaml#

title: Qualcomm APQ8064 ARM7 sensor processor

maintainers:
  - Gianluca Mazza <info@gianlucamazza.it>

description: |
  The APQ8064 DSPS sensor processor is an ARM7 with firmware in code TCM,
  buffer TCM, PIPE memory and reserved DDR. Secure firmware authentication
  and processor reset are provided by the Qualcomm peripheral authentication
  service. Sensors and their power management are owned by DSPS firmware.

properties:
  compatible:
    const: qcom,apq8064-dsps-pil

  reg:
    items:
      - description: PPSS control registers
      - description: DSPS code TCM
      - description: DSPS buffer TCM
      - description: DSPS PIPE memory

  reg-names:
    items:
      - const: ppss
      - const: tcm-code
      - const: tcm-buffer
      - const: pipe

  interrupts:
    items:
      - description: DSPS watchdog
      - description: DSPS SMSM reset notification

  interrupt-names:
    items:
      - const: watchdog
      - const: fatal

  memory-region:
    maxItems: 1
    description: Reserved, non-mapped DSPS DDR memory

  firmware-name:
    maxItems: 1

  smd-edge:
    $ref: /schemas/remoteproc/qcom,smd-edge.yaml#
    description: SMD communication edge between the AP and DSPS

required:
  - compatible
  - reg
  - reg-names
  - interrupts
  - interrupt-names
  - memory-region
  - smd-edge

additionalProperties: false

examples:
  - |
    #include <dt-bindings/interrupt-controller/arm-gic.h>
    #include <dt-bindings/interrupt-controller/irq.h>

    remoteproc@12080000 {
        compatible = "qcom,apq8064-dsps-pil";
        reg = <0x12080000 0x2000>, <0x12000000 0x28000>,
              <0x12040000 0x4000>, <0x12800000 0x4000>;
        reg-names = "ppss", "tcm-code", "tcm-buffer", "pipe";
        interrupts-extended = <&intc GIC_SPI 213 IRQ_TYPE_EDGE_RISING>,
                              <&dsps_smsm 6 IRQ_TYPE_EDGE_RISING>;
        interrupt-names = "watchdog", "fatal";
        memory-region = <&dsps_mem>;

        smd-edge {
            interrupts = <GIC_SPI 138 IRQ_TYPE_EDGE_RISING>;
            qcom,ipc = <&sps_sic_non_secure 0x4080 0>;
            qcom,smd-edge = <3>;
        };
    };
...
```

## drivers/usb/chipidea/Kconfig
```kconfig
# SPDX-License-Identifier: GPL-2.0

config USB_CHIPIDEA
	tristate "ChipIdea Highspeed Dual Role Controller"
	depends on ((USB_EHCI_HCD && USB_GADGET) || (USB_EHCI_HCD && !USB_GADGET) || (!USB_EHCI_HCD && USB_GADGET)) && HAS_DMA
	select EXTCON
	select RESET_CONTROLLER
	select USB_ULPI_BUS
	select USB_ROLE_SWITCH
	select USB_TEGRA_PHY if ARCH_TEGRA
	help
	  Say Y here if your system has a dual role high speed USB
	  controller based on ChipIdea silicon IP. It supports:
	  Dual-role switch (ID, OTG FSM, sysfs), Host-only, and
	  Peripheral-only.

	  When compiled dynamically, the module will be called ci_hdrc.ko.

if USB_CHIPIDEA

config USB_CHIPIDEA_UDC
	bool "ChipIdea device controller"
	depends on USB_GADGET
	help
	  Say Y here to enable device controller functionality of the
	  ChipIdea driver.

config USB_CHIPIDEA_HOST
	bool "ChipIdea host controller"
	depends on USB_EHCI_HCD
	select USB_EHCI_ROOT_HUB_TT
	help
	  Say Y here to enable host controller functionality of the
	  ChipIdea driver.

config USB_CHIPIDEA_PCI
	tristate "Enable PCI glue driver" if EXPERT
	depends on USB_PCI
	depends on NOP_USB_XCEIV
	default USB_CHIPIDEA

config USB_CHIPIDEA_MSM
	tristate "Enable MSM hsusb glue driver" if EXPERT
	default USB_CHIPIDEA

config USB_CHIPIDEA_MSM_BC12
	bool "Qualcomm APQ8064 USB source detection" if EXPERT || KUNIT
	depends on USB_CHIPIDEA_MSM=y && POWER_SUPPLY=y
	default y if ARCH_QCOM
	help
	  Detect SDP, CDP and DCP sources with the APQ8064 28 nm USB PHY
	  before the USB gadget joins the bus. Report the result through
	  the power supply subsystem so a charger can set its input current
	  according to the source. Other Qualcomm PHYs are unaffected.

config USB_CHIPIDEA_MSM_BC12_KUNIT_TEST
	bool "Test MSM USB source detection" if !KUNIT_ALL_TESTS
	depends on KUNIT && USB_CHIPIDEA_MSM_BC12
	default KUNIT_ALL_TESTS

config USB_CHIPIDEA_NPCM
	tristate "Enable NPCM hsusb glue driver" if EXPERT
	default USB_CHIPIDEA

config USB_CHIPIDEA_IMX
	tristate "Enable i.MX USB glue driver" if EXPERT
	depends on OF
	default USB_CHIPIDEA

config USB_CHIPIDEA_GENERIC
	tristate "Enable generic USB2 glue driver" if EXPERT
	default USB_CHIPIDEA

config USB_CHIPIDEA_TEGRA
	tristate "Enable Tegra USB glue driver" if EXPERT
	depends on OF
	default USB_CHIPIDEA

endif
```
